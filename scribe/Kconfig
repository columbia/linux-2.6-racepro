## scribe/Kconfig
```kconfig
#
# Scribe configuration
#

menuconfig SCRIBE
	bool "Scribe record/replay support"
	depends on EXPERIMENTAL
	select PID_NS
	select IPC_NS
	select MM_OWNER
	select DEVPTS_MULTIPLE_INSTANCES
	default y

if SCRIBE
endif # SCRIBE
```
